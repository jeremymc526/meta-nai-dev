## meta-75g5-x2/conf/layer.conf
```bitbake
# We have a conf and classes directory, add to BBPATH
BBPATH := "${LAYERDIR}:${BBPATH}"

# We have recipes-* directories, add to BBFILES
BBFILES += "${LAYERDIR}/recipes*/*/*.bb \
            ${LAYERDIR}/recipes*/*/*.bbappend"

BBFILE_COLLECTIONS += "75g5-x2"
BBFILE_PATTERN_75g5-x2 = "^${LAYERDIR}/"
BBFILE_PRIORITY_75g5-x2 = "10"

#See naii-image.bb (meta-nai/meta-75g5-x2/recipes-core/images)
#IMAGE_INSTALL_append = " nfs-utils-client"
#IMAGE_INSTALL_append = " memtool"
#IMAGE_INSTALL_append = " nfs-srv-init"
#


#Set hostname here
#  or in build/conf/local.conf
hostname_pn-base-files = "ChangeThisHostName"

 
```

## meta-75g5-x2/conf/machine/75g5-x2.conf
```bitbake
require conf/machine/zc702-zynq7.conf
#require conf/machine/include/soc-zynq.inc
#require conf/machine/include/machine-xilinx-default.inc
#

##NOTE You must include the ":=" and have a trailing ':'
FILESEXTRAPATHS_prepend := ":${THISDIR}/../../../../sources/meta-nai/:"



PREFERRED_PROVIDER_u-boot ?= "u-boot-75g5-x2"
PREFERRED_PROVIDER_virtual/bootloader ?= "u-boot-75g5-x2"
#PREFERRED_PROVIDER_virtual/bootloader = "u-boot"
#Double check these values.   Dont think these are right.   Just place holder for now
#UBOOT_ENTRYPOINT = "0x80200000"
#UBOOT_DTB_LOADADDRESS = "0x82200000"


UBOOT_ENV = "mmc-tftp"
PREFERRED_PROVIDER_external-hdf = "75g5-x2"

MACHINE_FEATURES = "ext3 vfat sdio"
SERIAL_CONSOLES ?= "115200;ttyPS0"

# Specify linux kernel devicetree
KERNEL_DEVICETREE = "zynq-zc702.dts"
MACHINE_ESSENTIAL_EXTRA_RDEPENDS += "device-tree"

DEVICE_TREE = "zynq-zc702"

UBOOT_MACHINE = "zynq_zc702_defconfig"
SPL_BINARY ?= "spl/boot.bin"
FORCE_PLATFORM_INIT = "1"
UBOOT_ELF = "u-boot"

EXTRA_IMAGEDEPENDS += " \
		u-boot-zynq-uenv \
		virtual/bitstream \
		virtual/bootloader \
		u-boot-zynq-scr \
		"

IMAGE_BOOT_FILES += " \
		boot.bin \
		bitstream \
		uEnv.txt \
		"

KERNEL_FEATURES += " \
		#bsp/xilinx/zybo-linux-bd-zynq7/zybo-linux-bd-zynq7.scc \
		#features/xilinx/v4l2/v4l2.scc \
		"

# Add EXTRA_IMAGEDEPENDS default components
EXTRA_IMAGEDEPENDS_append_zynqmp = " virtual/fsbl virtual/pmu-firmware arm-trusted-firmware"
EXTRA_IMAGEDEPENDS_append_zynq = " virtual/fsbl"
EXTRA_IMAGEDEPENDS_append_microblaze = " virtual/fsboot virtual/elfrealloc"


#Remove all qemu contents
IMAGE_CLASSES_remove = "image-types-xilinx-qemu qemuboot-xilinx"
IMAGE_FSTYPES_remove = "wic.qemu-sd"

EXTRA_IMAGEDEPENDS_remove = "qemu-helper-native virtual/boot-bin"
```
